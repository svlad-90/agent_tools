## agent_tools/paf_workspace/domains/xen_zephyr/assets/zephyr_module/zephyr/Kconfig
```kconfig
# SPDX-License-Identifier: Apache-2.0

menu "Xen runtime harness"

config XEN_HARNESS
	bool "Xen runtime harness support"
	depends on XEN
	help
	  Enables reusable helpers for Xen/QEMU validation products. This module
	  belongs to the workspace harness layer; it must not be enabled by
	  upstream samples just to make local logs easier to collect.

config XEN_HARNESS_DOMU_CONSOLE_COLLECTOR
	bool "Collect DomU PV console output from Dom0"
	depends on XEN_HARNESS && XEN_DOM0 && XEN_CONSOLE_SRV
	help
	  Starts a Dom0-side collector for DomU Xen PV console rings. DomU guests
	  using the regular xen,hvc-uart console write to a shared Xen console
	  page, not directly to QEMU serial. A normal Linux Dom0 would run
	  xenconsoled to drain those rings. This option provides the equivalent
	  validation-product hook for Zephyr Dom0 runtime images.

config XEN_HARNESS_DOMU_CONSOLE_SCAN_INTERVAL_MS
	int "DomU console scan interval"
	depends on XEN_HARNESS_DOMU_CONSOLE_COLLECTOR
	default 20
	help
	  Period, in milliseconds, used by the collector thread when polling for
	  new domain console data.

config XEN_HARNESS_DOMU_CONSOLE_COLLECTOR_AUTOSTART
	bool "Start the DomU console collector during boot"
	depends on XEN_HARNESS_DOMU_CONSOLE_COLLECTOR
	default y
	help
	  Starts the collector through SYS_INIT with the default Dom0 printk sink.
	  Products that need to install a custom host-visible sink should disable
	  this option, call xen_harness_log_collector_set_sink(), and then call
	  xen_harness_log_collector_start() from their own initialization code.

config XEN_HARNESS_DOMU_CONSOLE_MAX_DOMAINS
	int "Highest DomU domain ID scanned by the console collector"
	depends on XEN_HARNESS_DOMU_CONSOLE_COLLECTOR
	default 8
	help
	  Highest Xen domain ID the Dom0 collector polls for PV console output.
	  Domain 0 is Dom0 itself, so the collector scans DomU domains 1 through
	  this value.

config XEN_HARNESS_DOMU_CONSOLE_STACK_SIZE
	int "DomU console collector stack size"
	depends on XEN_HARNESS_DOMU_CONSOLE_COLLECTOR
	default 2048

config XEN_HARNESS_DOMU_CONSOLE_PRIORITY
	int "DomU console collector thread priority"
	depends on XEN_HARNESS_DOMU_CONSOLE_COLLECTOR
	default 7

config XEN_HARNESS_DOMU_AUTOSTART
	bool "Create a DomU from Zephyr Dom0 during boot"
	depends on XEN_HARNESS_DOMU_CONSOLE_COLLECTOR && XEN_DOMAIN_MANAGEMENT
	help
	  Creates one test DomU through xenlib after Zephyr Dom0 starts. This is
	  intended for validation products that need normal Xenlib-created DomU
	  resources such as XenStore and PV console rings instead of static
	  dom0less domains described directly in Xen's boot device tree.

config XEN_HARNESS_DOMU_AUTOSTART_NAME
	string "Autostart DomU name"
	depends on XEN_HARNESS_DOMU_AUTOSTART
	default "xen-harness-domu"

config XEN_HARNESS_DOMU_AUTOSTART_MEMORY_KB
	int "Autostart DomU memory in KiB"
	depends on XEN_HARNESS_DOMU_AUTOSTART
	default 16384

config XEN_HARNESS_DOMU_AUTOSTART_VCPUS
	int "Autostart DomU vCPU count"
	depends on XEN_HARNESS_DOMU_AUTOSTART
	default 1

config XEN_HARNESS_DOMU_AUTOSTART_DOMID
	int "Autostart DomU domain ID"
	depends on XEN_HARNESS_DOMU_AUTOSTART
	default 1
	help
	  Domain ID passed to Xen's create-domain control operation. The runtime
	  smoke disables Xen static DomU creation, so domain 1 is normally free.

config XEN_HARNESS_DOMU_AUTOSTART_SSIDREF
	int "Autostart DomU XSM security label ID"
	depends on XEN_HARNESS_DOMU_AUTOSTART
	default 12
	help
	  Xen Security Modules identify domain labels by a numeric SSID value.
	  Zephyr-xenlib does not translate FLASK label strings, so this value must
	  match the Xen build's generated flask.h. The default follows the
	  zephyr-xenlib README example for domU_t, where SECINITSID_DOMU is 12.

config XEN_HARNESS_DOMU_AUTOSTART_TRAP_UNMAPPED_ACCESSES
	bool "Trap unmapped DomU accesses"
	depends on XEN_HARNESS_DOMU_AUTOSTART
	help
	  Adds XEN_DOMCTL_CDF_trap_unmapped_accesses to the dynamic DomU creation
	  flags. Xen 4.21 ARM HVM DomU console pages need this to behave like the
	  dom0less path instead of dropping accesses to the shared console ring.

config XEN_HARNESS_DOMU_AUTOSTART_DELAY_MS
	int "Autostart DomU boot delay"
	depends on XEN_HARNESS_DOMU_AUTOSTART
	default 500

config XEN_HARNESS_DOMU_AUTOSTART_CMDLINE
	string "Autostart DomU kernel command line"
	depends on XEN_HARNESS_DOMU_AUTOSTART
	default "console=hvc0"

endmenu
```

## codex_tools/paf_workspace/domains/xen-zephyr/assets/linux_yocto_layer/meta-xen-harness/conf/layer.conf
```bitbake
BBPATH .= ":${LAYERDIR}"
BBFILES += "${LAYERDIR}/recipes-*/*/*.bb ${LAYERDIR}/recipes-*/*/*.bbappend"

BBFILE_COLLECTIONS += "xen-harness"
BBFILE_PATTERN_xen-harness = "^${LAYERDIR}/"
BBFILE_PRIORITY_xen-harness = "7"

LAYERSERIES_COMPAT_xen-harness = "kirkstone"
```

## codex_tools/xen_harness/zephyr_module/zephyr/Kconfig
```kconfig
# SPDX-License-Identifier: Apache-2.0

menu "Xen runtime harness"

config XEN_HARNESS
	bool "Xen runtime harness support"
	depends on XEN
	help
	  Enables reusable helpers for Xen/QEMU validation products. This module
	  belongs to the workspace harness layer; it must not be enabled by
	  upstream samples just to make local logs easier to collect.

config XEN_HARNESS_DOMU_CONSOLE_COLLECTOR
	bool "Collect DomU PV console output from Dom0"
	depends on XEN_HARNESS && XEN_DOM0
	help
	  Starts a Dom0-side collector for DomU Xen PV console rings. DomU guests
	  using the regular xen,hvc-uart console write to a shared Xen console
	  page, not directly to QEMU serial. A normal Linux Dom0 would run
	  xenconsoled to drain those rings. This option provides the equivalent
	  validation-product hook for Zephyr Dom0 runtime images.

config XEN_HARNESS_DOMU_CONSOLE_SCAN_INTERVAL_MS
	int "DomU console scan interval"
	depends on XEN_HARNESS_DOMU_CONSOLE_COLLECTOR
	default 100
	help
	  Period, in milliseconds, used by the collector thread when polling for
	  new domain console data.

config XEN_HARNESS_DOMU_CONSOLE_STACK_SIZE
	int "DomU console collector stack size"
	depends on XEN_HARNESS_DOMU_CONSOLE_COLLECTOR
	default 2048

config XEN_HARNESS_DOMU_CONSOLE_PRIORITY
	int "DomU console collector thread priority"
	depends on XEN_HARNESS_DOMU_CONSOLE_COLLECTOR
	default 7

endmenu
```
